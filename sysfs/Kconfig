## sysfs/Kconfig
```kconfig
# SUSFS - Spoofed User Space File System
# Independent from KernelSU Kconfig

menu "SUSFS (Spoofed User Space File System)"

config KSU_SUSFS
	bool "Enable SUSFS (Spoofed User Space File System)"
	default y
	help
	  Enable SUSFS kernel-level filesystem spoofing for root hiding.
	  Requires KernelSU (CONFIG_KSU=y) to function.

config KSU_SUSFS_SUS_PATH
	bool "Enable to hide suspicious path"
	depends on KSU_SUSFS
	default y
	help
	  Allow hiding the user-defined path and all its sub-paths from various system calls.
	  Effective on process with uid > 2000 only.

config KSU_SUSFS_SUS_MOUNT
	bool "Enable to hide suspicious mounts"
	depends on KSU_SUSFS
	default y
	help
	  Allow hiding the user-defined mount paths from /proc/self/[mounts|mountinfo|mountstat].
	  Effective on all processes for hiding mount entries.

config KSU_SUSFS_SUS_KSTAT
	bool "Enable to spoof suspicious kstat"
	depends on KSU_SUSFS
	default y
	help
	  Allow spoofing the kstat of user-defined file/directory.

config KSU_SUSFS_SUS_OVERLAYFS
	bool "Enable to automatically spoof kstat and kstatfs for overlayed files"
	depends on KSU_SUSFS
	default y
	help
	  Automatically spoof the kstat and kstatfs for overlayed files/directories.

config KSU_SUSFS_TRY_UMOUNT
	bool "Enable to use ksu's try_umount"
	depends on KSU_SUSFS
	default y
	help
	  Allow using ksu's umount to umount other user-defined mount paths.

config KSU_SUSFS_SPOOF_UNAME
	bool "Enable to spoof uname"
	depends on KSU_SUSFS
	default y
	help
	  Allow spoofing the string returned by uname syscall.

config KSU_SUSFS_ENABLE_LOG
	bool "Enable logging susfs log to kernel"
	depends on KSU_SUSFS
	default y
	help
	  Allow logging susfs log to kernel.

config KSU_SUSFS_SUS_SU
	bool "Enable SUS-SU in runtime (experimental)"
	depends on KSU_SUSFS
	default y
	help
	  Allow user to enable or disable core ksu kprobes hooks temporarily in runtime.

endmenu
```
